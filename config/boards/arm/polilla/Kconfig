## config/boards/arm/polilla/Kconfig
```kconfig
# Polilla board configuration

# Copyright (c) 2025 elagil
# SPDX-License-Identifier: MIT

config BOARD_ENABLE_DCDC
	bool "Enable DCDC mode"
	select SOC_DCDC_NRF52X
	default y
	depends on BOARD_POLILLA
```

## config/boards/arm/polilla/Kconfig.defconfig
```kconfig
# Polilla board configuration

# Copyright (c) 2025 elagil
# SPDX-License-Identifier: MIT

if BOARD_POLILLA

config ZMK_KEYBOARD_NAME
	default "Polilla"

config USB_NRFX
	default y

config BT_CTLR
	default BT

endif # BOARD_POLILLA
```

## config/west.yml
```yaml
manifest:
  remotes:
    - name: zmkfirmware
      url-base: https://github.com/zmkfirmware
  projects:
    - name: zmk
      remote: zmkfirmware
      revision: c7fb418e88bc3d5e82f04976c06a1aeeb9b5c736
      import: app/west.yml
  self:
    path: config
```
