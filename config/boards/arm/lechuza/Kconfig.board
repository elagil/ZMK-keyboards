## config/boards/arm/lechuza/Kconfig.board
```kconfig
# Lechuza board configuration

# Copyright (c) 2022 elagil
# SPDX-License-Identifier: MIT

config BOARD_LECHUZA
	bool "Lechuza"
	depends on SOC_STM32L072XX
```

## config/boards/arm/lechuza/Kconfig.defconfig
```kconfig
# Lechuza board configuration

# Copyright (c) 2022 elagil
# SPDX-License-Identifier: MIT

if BOARD_LECHUZA

config BOARD
    default "lechuza"

config ZMK_KEYBOARD_NAME
	default "Lechuza"

config ZMK_KSCAN_MATRIX_POLLING
	default y

endif # BOARD_LECHUZA
```

## config/boards/arm/lechuza/lechuza_defconfig
```kconfig
# Lechuza board configuration

# Copyright (c) 2022 elagil
# SPDX-License-Identifier: MIT

CONFIG_SOC_SERIES_STM32L0X=y
CONFIG_SOC_STM32L072XX=y

# 32 MHz system clock
CONFIG_SYS_CLOCK_HW_CYCLES_PER_SEC=32000000

CONFIG_PINCTRL=y
CONFIG_GPIO=y

# ZMK Settings
CONFIG_ZMK_USB=y

# clock configuration
CONFIG_CLOCK_CONTROL=y
```

## config/boards/arm/polilla/Kconfig.board
```kconfig
# Polilla board configuration

# Copyright (c) 2025 elagil
# SPDX-License-Identifier: MIT

config BOARD_POLILLA
	bool "polilla"
	depends on SOC_NRF52840_QIAA
```

## config/boards/lechuza/lechuza_defconfig
```kconfig
# SPDX-License-Identifier: MIT

CONFIG_BOARD_LECHUZA=y
CONFIG_SOC_SERIES_STM32L0X=y
CONFIG_SOC_STM32L072XX=y

# 32 MHz system clock
CONFIG_SYS_CLOCK_HW_CYCLES_PER_SEC=32000000

# enable PINMUX
CONFIG_PINMUX=y

# enable GPIO
CONFIG_GPIO=y

# ZMK Settings
CONFIG_ZMK_USB=y
CONFIG_ZMK_KSCAN_GPIO_DRIVER=y
CONFIG_ZMK_KSCAN_MATRIX_POLLING=y
CONFIG_USB_SELF_POWERED=n

# clock configuration
CONFIG_CLOCK_CONTROL=y

# Clock configuration for Cube Clock control driver
CONFIG_CLOCK_STM32_SYSCLK_SRC_PLL=y
# use HSI as PLL input
CONFIG_CLOCK_STM32_PLL_SRC_HSI=y

# produce 32 MHz clock at PLL output
CONFIG_CLOCK_STM32_PLL_PREDIV=2
CONFIG_CLOCK_STM32_PLL_MULTIPLIER=4
CONFIG_CLOCK_STM32_AHB_PRESCALER=1
CONFIG_CLOCK_STM32_APB1_PRESCALER=1
CONFIG_CLOCK_STM32_APB2_PRESCALER=1
```
